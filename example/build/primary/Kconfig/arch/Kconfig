## example/build/primary/Kconfig/arch/Kconfig
```kconfig
# Load Zephyr Arch Kconfig descriptions.
osource "/home/mbayi/zephyrproject/zephyr/arch/tricore/Kconfig"
osource "/home/mbayi/zephyrproject/zephyr/arch/hexagon/Kconfig"
osource "/home/mbayi/zephyrproject/zephyr/arch/rx/Kconfig"
osource "/home/mbayi/zephyrproject/zephyr/arch/x86/Kconfig"
osource "/home/mbayi/zephyrproject/zephyr/arch/xtensa/Kconfig"
osource "/home/mbayi/zephyrproject/zephyr/arch/sparc/Kconfig"
osource "/home/mbayi/zephyrproject/zephyr/arch/riscv/Kconfig"
osource "/home/mbayi/zephyrproject/zephyr/arch/posix/Kconfig"
osource "/home/mbayi/zephyrproject/zephyr/arch/openrisc/Kconfig"
osource "/home/mbayi/zephyrproject/zephyr/arch/mips/Kconfig"
osource "/home/mbayi/zephyrproject/zephyr/arch/arm64/Kconfig"
osource "/home/mbayi/zephyrproject/zephyr/arch/arm/Kconfig"
osource "/home/mbayi/zephyrproject/zephyr/arch/arc/Kconfig"
```

## example/build/primary/Kconfig/boards/Kconfig
```kconfig
# Load Zephyr board Kconfig descriptions.
osource "/home/mbayi/zephyrproject/zephyr/boards/st/nucleo_f446re/Kconfig"
```

## example/build/primary/Kconfig/boards/Kconfig.defconfig
```kconfig
# Load Zephyr board defconfig descriptions.
osource "/home/mbayi/zephyrproject/zephyr/boards/st/nucleo_f446re/Kconfig.defconfig"
```

## example/build/primary/Kconfig/boards/Kconfig.sysbuild
```kconfig
# Load Sysbuild board Kconfig descriptions.
osource "/home/mbayi/zephyrproject/zephyr/boards/st/nucleo_f446re/Kconfig.sysbuild"
```

## modules/drivers/lcm1602/Kconfig
```kconfig
config LCM1602
    bool "LCM1602 I2C LCD driver"
    default n
    depends on I2C
    help
      Enable the LCM1602 character LCD driver.
      This driver usually communicates via an I2C I/O expander.
```

## modules/dts/bindings/lcm1602/lcm1602.yaml
```yaml
description: number of display lines either 1 or 2
compatible: "lcm1602"

include: base.yaml
on-bus: i2c
properties:
  display_mode:
    type: int
    enum:
      - 1
      - 2
    default: 2
    description: "number of display lines "

  idl:
    type: int 
    enum:
      - 4
      - 8
    default: 4
    description: "interface data length can be 4 bit or 8 bit can take values 4 or 8"
    
  format: 
    type: string
    enum:
      - "5x8"
      - "5x11"
    default: "5x8"
    description: "dot matrix  size per character"
```
